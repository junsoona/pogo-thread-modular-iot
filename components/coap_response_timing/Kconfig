## components/coap_response_timing/Kconfig
```kconfig
menu "CoAP Response Timing (sensor_transport /s + topology_reporter /t)"

    config SENSOR_COAP_ACK_TIMEOUT_MS
        int "CoAP ACK timeout (ms) for sensor_transport and topology_reporter"
        default 2000
        help
            otCoapTxParameters.mAckTimeout used by BOTH sensor_transport's
            "/s" sends and topology_reporter's "/t" sends -- ONE shared
            value so the two components can never silently drift apart (see
            components/coap_response_timing's own header comment for why
            this must also stay comfortably LONGER than a LEAF's own Thread
            SED data-poll period, CONFIG_THREAD_MANAGER_LEAF_DATA_POLL_PERIOD_MS,
            not shorter -- the two Kconfig defaults, 2000ms and 500ms, are
            chosen so a SED polls roughly 4x within one ACK-timeout window).
            Each send still uses mMaxRetransmit=0 (the application-level
            retry loop in each component owns retries, not OpenThread's).

endmenu
```

## components/linux_bridge_exporter/Kconfig
```kconfig
menu "Linux Bridge Exporter (Power Base -> Linux OTBR host)"

    config LINUX_BRIDGE_EXPORTER_QUEUE_LEN
        int "Bounded TOPOLOGY export event queue depth"
        default 32
        help
            Depth of the FIFO queue between power_base_transport's
            on_topology_applied/on_node_offline bridge-observer callbacks
            (OT-task context, non-blocking enqueue only) and this
            component's own sending task. A full queue drops the newest
            TOPOLOGY event with a rate-limited warning rather than blocking
            the OT task or halting anything -- see
            components/linux_bridge_exporter's own header comment. The
            periodic full topology resync below recovers any dropped event.
            (Correction pass: SAMPLE events no longer share this queue at
            all -- see PENDING_SAMPLES_MAX in linux_bridge_exporter.c, a
            fixed-size, always-coalescing-by-uuid table sized to
            SENSOR_ROOT_AGGREGATOR_MAX_NODES, not a Kconfig value.)

    config LINUX_BRIDGE_EXPORTER_FULL_RESYNC_INTERVAL_MS
        int "Full topology + latest-sample resync interval (ms)"
        default 5000
        help
            Every this many ms, resend every topology_registry node's
            CURRENT state AND every sensor_root_aggregator node's CURRENT
            (most recent) sample to the Linux host, regardless of whether
            anything changed -- recovers from a dropped/coalesced-away
            event, a stale/rebuilt Linux registry, or a Linux OTBR host that
            just restarted, without waiting for that module's next sensor
            measurement (this follow-up's own explicit requirement).

    config LINUX_BRIDGE_EXPORTER_HEARTBEAT_INTERVAL_MS
        int "Bridge exporter heartbeat interval (ms)"
        default 10000
        help
            Liveness-only signal (power_base_uuid + uptime_ms + node_count);
            never authoritative -- the periodic full resync above is what
            actually reconciles Linux-side state.

    config LINUX_BRIDGE_EXPORTER_SAMPLE_MIN_INTERVAL_MS
        int "Minimum interval between two SAMPLE publishes for the SAME module_uuid (ms)"
        default 1000
        help
            Transport-load reduction (Power Base -> Linux, this pass): caps
            how often this component actually PUBLISHES a SAMPLE for any one
            module_uuid, regardless of how often that module's sensor
            measurement/aggregator storage updates -- neither the sensor
            measurement period nor the aggregator's own storage rate is
            changed by this setting, only how often the ALREADY-STORED
            latest value is mirrored to the Linux host.

            Precise unit (correction pass -- see linux_bridge_exporter.c's
            own top comment): this bounds LOGICAL SAMPLE PUBLISHES, not
            individual CoAP attempts. One logical publish is the whole
            bounded transmit_sample() attempt sequence for a uuid (1 initial
            attempt + up to 2 transient-failure retries, all re-reading the
            CURRENT sensor_root_aggregator value immediately before each
            individual attempt) -- that whole sequence counts as ONE publish
            against this interval, dispatched at most once per interval per
            uuid, never once per retry.

            ALL SAMPLE publish paths share this SAME per-uuid gate now,
            including the periodic full resync
            (LINUX_BRIDGE_EXPORTER_FULL_RESYNC_INTERVAL_MS): a resync tick
            only marks each uuid's current aggregator value as pending
            again, it never dispatches a SAMPLE directly -- so a reactive
            publish immediately followed by a resync tick can never produce
            a second SAMPLE publish for the same uuid inside one interval
            window. Worst-case SAMPLE convergence after a dropped/missed
            event is therefore bounded by resync_interval + at most one
            SAMPLE_MIN_INTERVAL_MS window, not exactly resync_interval.

            Rapid samples for the same uuid within this window keep
            coalescing (mark-pending, latest-wins) exactly as before; once
            the window reopens, the then-CURRENT aggregator value (never a
            cached/stale one) is published. If every attempt in a publish
            sequence hits a transient failure, the uuid is left pending
            again so the NEXT allowed window retries with whatever is
            current at that later time -- never a busy loop, never a
            replayed stale value.

            TOPOLOGY events (ATTACHED/UPDATED/DETACHED/OFFLINE, parent-state
            changes) are a COMPLETELY SEPARATE path (s_topology_pending_*/
            s_topology_queue) and are NOT subject to this limit at all --
            they are always sent immediately, including the periodic full
            TOPOLOGY resync.

endmenu
```

## components/pogo_proto/Kconfig
```kconfig
menu "POGO UART Protocol"

    config POGO_UART_PORT_NUM
        int "POGO UART port number"
        default 1
        help
            UART peripheral used for the POGO wired link (UART0 is normally
            reserved for the console/programming port).

    config POGO_UART_TX_GPIO
        int "POGO UART TX GPIO"
        default 10
        help
            Upper TX -> Lower RX. Chosen to avoid ESP32-H2 USB (GPIO26/27),
            boot strapping pins (GPIO8/9/25) and the SuperMini onboard LED
            (GPIO8/13). Change here if the real board wiring differs.

    config POGO_UART_RX_GPIO
        int "POGO UART RX GPIO"
        default 11
        help
            Upper RX <- Lower TX. See POGO_UART_TX_GPIO for pin selection notes.

    config POGO_UART_BAUD_RATE
        int "POGO UART baud rate"
        default 115200

    config POGO_UART_RX_BUF_SIZE
        int "POGO UART driver RX ring buffer size"
        default 512

    config POGO_UART_TX_BUF_SIZE
        int "POGO UART driver TX ring buffer size"
        default 512

    config POGO_PING_INTERVAL_MS
        int "Upper: docking-detection PING interval (ms)"
        default 1000
        help
            While no lower module has answered, the upper module sends a
            PING at this interval and treats a valid PONG as "docked".

    config POGO_ACK_TIMEOUT_MS
        int "Control message ACK/NACK timeout (ms)"
        default 300
        help
            Timeout for short request/response exchanges (identify, assign
            UUID, assign slot, dataset transfer). Separate from the Thread
            join timeout, which is much longer.

    config POGO_JOIN_TIMEOUT_MS
        int "Thread join timeout (ms)"
        default 20000
        help
            Maximum time the lower module waits after applying the Active
            Dataset for its Thread role to leave DETACHED before reporting
            join failure to the upper module.

    config POGO_MAX_RETRY
        int "Max retries per pairing step"
        default 3

    config POGO_ATTACH_SETTLE_MS
        int "AUTO mode: settle time after DETECT_IN debounces attached, before the first handshake (ms)"
        default 150
        help
            DETECT_IN can close a few ms before the UART/GND pogo contacts
            fully seat during a real dock motion. A bounded, explicit delay
            here (not a busy loop -- see pogo_port.c's PORT_STATE_ATTACH_SETTLE)
            gives those contacts time to settle before the first HELLO_REQ is
            sent, instead of racing a handshake against still-bouncing
            contacts. Cancelled immediately (falls back to WAIT_ATTACH) if
            DETECT_IN debounces back to detached during this window.

    config POGO_HOTSWAP_COOLDOWN_MS
        int "AUTO mode: cooldown before auto-retrying a transient handshake failure (ms)"
        default 3000
        help
            DOCK_TIMEOUT and LIVENESS_LOST are transient: if DETECT_IN still
            reads attached (no physical detach), a fresh handshake cycle
            starts automatically after this cooldown instead of requiring a
            new DETECT_IN edge -- covers a real dock where DETECT closes
            before UART/GND, so the first handshake cycle times out with no
            edge left to recover on. Cancelled immediately if DETECT_IN
            debounces to detached during the cooldown. Configuration/
            compatibility errors (PEER_TYPE_CONFLICT, PROTOCOL_VERSION_ERROR,
            CAPABILITY_MISMATCH) are NOT covered by this -- those still
            require a physical detach/reattach before retrying.

    config POGO_DETECT_RECONCILE_MS
        int "AUTO mode: DETECT_IN direct-read reconciliation interval (ms)"
        default 500
        help
            Backstop against a missed GPIO ISR or a full detect_queue
            (dropped edges, see pogo_port.c's detect_isr_drops counter): at
            this interval, the port task directly re-reads DETECT_IN's raw
            level and, if it disagrees with the level this port's debounce
            state currently believes, injects a synthetic edge so the normal
            debounce/commit path resynchronizes -- rather than staying
            wedged on a stale committed level until some unrelated later
            edge happens to correct it.

endmenu
```

## components/thread_manager/Kconfig
```kconfig
menu "Thread Manager"

    config THREAD_MANAGER_LEAF_DATA_POLL_PERIOD_MS
        int "LEAF Thread SED MAC data poll period (ms)"
        default 500
        help
            otLinkSetPollPeriod() value applied to every LEAF join
            (components/thread_manager's thread_manager_join_with_dataset(),
            when its own thread_data_poll_period_ms argument is 0) -- how
            often this SED wakes its radio to ask its parent whether it has
            anything queued for it.

            This is DELIBERATELY INDEPENDENT of any sensor measurement/
            sampling period (see child_service's own POLL_CONFIG handling
            and sensor_service) -- a real-hardware finding showed that
            reusing a multi-second sensor sampling period here made this
            device's own CoAP client (sensor_transport/topology_reporter)
            give up waiting for a response before this device's next data
            poll could even retrieve it from its parent, well before any
            data was actually lost. Keep this comfortably shorter than
            CONFIG_SENSOR_COAP_ACK_TIMEOUT_MS (components/
            coap_response_timing) -- see docs/power-base.md's SED CoAP
            response timing section. May be tuned lower for responsiveness
            or higher for power savings once real measurements are
            available; this Kconfig default (500ms) is a prototype value,
            not a measured optimum.

endmenu
```

## components/topology_reporter/Kconfig
```kconfig
menu "Topology Reporter"

    config TOPOLOGY_REPORTER_HEARTBEAT_INTERVAL_MS
        int "Topology heartbeat report interval (ms)"
        default 30000
        help
            While attached (role_manager_is_upstream_ready() and role is
            LEAF or INTERMEDIATE) with nothing else to report, send a
            TOPOLOGY_REPORT_HEARTBEAT this often. Should be comfortably
            shorter than the power base's own configured
            heartbeat_timeout_ms/topology_stale_timeout_ms (see
            power_base_config.h and configs/power_base.json) so a
            momentarily-delayed report is not mistaken for a real detach.

endmenu
```
